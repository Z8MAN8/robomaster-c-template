## board/Kconfig
```kconfig
menu "Hardware Drivers Config"

config SOC_STM32F407IG
    bool
    select SOC_SERIES_STM32F4
    select RT_USING_COMPONENTS_INIT
    select RT_USING_USER_MAIN
    default y

menu "Onboard Peripheral Drivers"

endmenu

menu "On-chip Peripheral Drivers"
    config BSP_USING_PIN
        bool "Enable PIN"
        default y

    config BSP_USING_UART
        bool "Enable UART"
        default y

    config BSP_USING_CAN
        bool "Enable CAN"
        default y

    config BSP_USING_DWT
        bool "Enable DWT"
        default y

endmenu

menu "RoboMaster Modules"
    menuconfig BSP_USING_MOTOR
        bool "Select USING Motors"
        default y
        if BSP_USING_MOTOR
            config BSP_USING_DJI_MOTOR
                bool "Using DJI Motors"
                default y
        endif

endmenu

menu "Board extended module Drivers"

endmenu

menu "Development Tools"

    config BSP_USING_EASYFLASH
        bool "Enable EasyFlash"
        default n

endmenu

endmenu
```
